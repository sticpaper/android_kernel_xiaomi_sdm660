## drivers/input/touchscreen/gt9xx/Kconfig
```kconfig
config TOUCHSCREEN_GT9XX
	bool "Goodix touchpanel GT9xx series"
	depends on I2C
	help
	  Say Y here if you have a Goodix GT9xx touchscreen
	  controller.

          If unsure, say N.
```
